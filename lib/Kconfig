## lib/Kconfig
```kconfig
config UBI_ENABLE
	bool "Enable UBI library"
	depends on FLASH && FLASH_MAP && CRC
	help
	  Enable the Unsorted Block Images (UBI) library.
	  UBI provides wear-leveling, bad block management, and
	  multiple logical volumes on raw flash partitions.

if UBI_ENABLE

rsource "Kconfig.plain"
rsource "Kconfig.secure"

choice UBI_MEM_BACKEND
	prompt "UBI memory backend"
	default UBI_MEM_BACKEND_STATIC
	help
	  Select the memory allocation backend for UBI runtime
	  data structures. The static backend uses k_mem_slab
	  pools sized at compile time; the heap backend uses
	  k_malloc / k_free from the global Zephyr heap.

config UBI_MEM_BACKEND_STATIC
	bool "Static (k_mem_slab)"
	help
	  All UBI allocations come from fixed-size slab pools.
	  Provides deterministic RAM budget and isolates UBI
	  from the application heap. Requires setting
	  CONFIG_UBI_MAX_NR_OF_DEVICES and
	  CONFIG_UBI_MAX_NR_OF_DATA_PEBS to match the flash
	  geometry.

config UBI_MEM_BACKEND_HEAP
	bool "Heap (k_malloc)"
	help
	  UBI allocations use the global Zephyr heap.
	  No compile-time pool sizing required, but memory
	  is shared with the rest of the application.

endchoice

config UBI_MAX_NR_OF_DEVICES
	int "Maximum number of concurrent UBI devices"
	default 1
	range 1 4
	help
	  Upper limit on the number of UBI device handles that
	  can exist simultaneously. Multiplies all slab pool
	  sizes when the static backend is selected.

config UBI_MAX_NR_OF_DATA_PEBS
	int "Maximum number of data PEBs per device"
	default 14
	range 1 4096
	help
	  Upper limit on the number of data PEBs (total PEBs
	  minus reserved PEBs) for a single UBI device. Used
	  by the static backend to size the small-item slab
	  pool. Must be >= total_data_peb_count of every flash
	  partition managed by UBI.

module = UBI
module-str = ubi
source "subsys/logging/Kconfig.template.log_config"

config UBI_TEST_API_ENABLE
	bool "Enable internal UBI test API"
	help
	  Expose ubi_device_get_peb_ec() and
	  ubi_device_check_invariants() for test suites.
	  Do not enable in production builds.

config UBI_TEST_MEM_STATS
	bool "Enable UBI memory pool statistics"
	default n
	depends on UBI_TEST_API_ENABLE && UBI_MEM_BACKEND_STATIC
	help
	  When enabled, UBI logs slab pool high-water marks
	  during device deinit for diagnostic purposes.

config UBI_TEST_FAULT_INJECTION
	bool "Enable UBI fault injection hooks"
	depends on UBI_TEST_API_ENABLE
	help
	  Wraps memory allocations with a test-controllable hook
	  that can be configured to fail after N calls. Used for
	  testing transactional safety under allocation failures.
	  Do not enable in production builds.

endif # UBI_ENABLE
```

## lib/Kconfig.plain
```kconfig
# UBI Plain Backend Kconfig
#
# Configuration specific to the plain (unencrypted) UBI backend.
# Sourced by lib/Kconfig when UBI_ENABLE=y.

config UBI_DEV_HDR_NR_OF_RES_PEBS
	int "Number of reserved PEBs for device and volume headers"
	default 2
	range 2 4
	help
	  Number of physical erase blocks reserved for storing
	  device and volume headers. Two PEBs are always kept
	  active (dual-bank). Additional PEBs serve as cold spares
	  that are promoted when an active PEB fails permanently.
	  Increasing this value reduces the number of data PEBs
	  available for volumes.

config UBI_MAX_NR_OF_VOLUMES
	int "Maximum number of volumes per UBI device"
	default 10
	range 1 128
	help
	  Upper limit on the number of volumes that can be created
	  on a single UBI device. Each volume header occupies 48 bytes
	  on the reserved PEBs so this value is constrained by the
	  erase block size.

config UBI_PEB_WRITE_RETRY_COUNT
	int "Number of write retries for data PEBs"
	default 3
	range 1 5
	help
	  Number of times to retry a failed flash write on data PEBs
	  before propagating the error to the caller. Applies to EC
	  header, VID header, and LEB data writes performed through
	  the I/O layer. Reserved PEB writes are excluded because they
	  use a separate multi-PEB fallback mechanism.
	  Set to 1 for a single attempt (no retry).

config UBI_BAD_PEB_TORTURE_CYCLES
	int "Number of bad PEBs to torture per erase_peb call"
	default 3
	range 1 10
	help
	  Limits the number of bad PEBs processed by the torture
	  test in a single ubi_device_erase_peb() invocation.
	  This bounds the worst-case latency of the erase path.

config UBI_BAD_PEB_TORTURE_MAX_PER_ERASE
	int "Maximum erase attempts per bad PEB during torture"
	default 1
	range 1 10
	help
	  When a PEB is marked bad at runtime, the torture test
	  attempts up to this many erases. If any erase succeeds,
	  the PEB is considered healthy and returned to the free
	  pool. If all attempts fail, the PEB stays bad.
```

## lib/Kconfig.secure
```kconfig
# UBI Secure Backend Kconfig
#
# This file is sourced by lib/Kconfig when UBI_ENABLE=y.

menuconfig UBI_CRYPTO
	bool "Enable UBI secure (authenticated-encryption) backend"
	depends on UBI_ENABLE
	depends on MBEDTLS
	depends on MBEDTLS_PSA_CRYPTO_C
	depends on ENTROPY_GENERATOR
	depends on MBEDTLS_ENTROPY_POLL_ZEPHYR
	select PSA_WANT_ALG_CCM
	select PSA_WANT_ALG_HKDF
	select PSA_WANT_ALG_SHA_256
	select PSA_WANT_KEY_TYPE_AES
	help
	  Enable the secure backend for UBI devices. When enabled, devices
	  initialized with a non-NULL crypto_cfg use AES-128-CCM authenticated
	  encryption for all on-flash structures. Requires PSA Crypto via
	  Mbed TLS and a platform entropy source.

if UBI_CRYPTO

# --- Key version limits ---

config UBI_CRYPTO_MAX_KEY_VERSIONS
	int "Maximum distinct key versions per attach session"
	default 4
	range 1 255
	help
	  Upper bound on the number of distinct key versions that may be
	  active during a single attach session. Determines the size of
	  per-key-version bookkeeping arrays and limits the
	  ubi_crypto_policy.allowed_key_versions array length.

# --- Budget limits ---

config UBI_CRYPTO_METADATA_COUNTER_BUDGET
	int "Max metadata AEAD invocations per {domain, key_version}"
	default 1000000
	help
	  Maximum number of AEAD encrypt operations for metadata headers
	  (device header, volume header) per domain and key version before
	  a key rotation event is triggered.

config UBI_CRYPTO_METADATA_TOTAL_AUTH_BYTES_BUDGET
	int "Max authenticated metadata bytes per {domain, key_version}"
	default 100000000
	help
	  Maximum cumulative authenticated bytes (AAD + plaintext) for
	  metadata AEAD operations per domain and key version.

config UBI_CRYPTO_LEB_WRITE_BUDGET
	int "Max LEB AEAD invocations per {key_version, volume_id}"
	default 1000000
	help
	  Maximum number of AEAD encrypt operations for LEB data records
	  per key version and volume before a key rotation event is triggered.

config UBI_CRYPTO_LEB_TOTAL_AUTH_BYTES_BUDGET
	int "Max cumulative authenticated LEB bytes per {key_version, volume_id}"
	default 100000000
	help
	  Maximum cumulative authenticated bytes (AAD + plaintext) for LEB
	  AEAD operations per key version and volume.

# --- Rotation thresholds ---

config UBI_CRYPTO_ROTATE_SOON_PCT
	int "Soft rotation threshold (percentage)"
	default 80
	range 1 99
	help
	  When usage reaches this percentage of any budget, the secure
	  backend emits KEY_ROTATE_SOON. The application should prepare
	  a replacement key.

config UBI_CRYPTO_ROTATE_NOW_PCT
	int "Hard rotation threshold (percentage)"
	default 95
	range 1 100
	help
	  When usage reaches this percentage of any budget, the secure
	  backend emits KEY_ROTATE_NOW. If no replacement key is available,
	  writes may be rejected.

# --- Chunked mode ---

config UBI_CRYPTO_LEB_CHUNKED
	bool "Enable chunked secure LEB layout"
	help
	  Use multiple AEAD tags per LEB for large PEB geometries. Allows
	  partial-LEB reads without authenticating the entire payload.

config UBI_CRYPTO_LEB_CHUNK_SIZE
	int "Chunk size in bytes for chunked LEB layout"
	default 4096
	range 256 65536
	depends on UBI_CRYPTO_LEB_CHUNKED
	help
	  Size of each independently authenticated chunk within a secure
	  LEB record. Smaller values allow finer-grained reads but increase
	  per-LEB overhead (16 bytes tag per chunk).

# --- PEB cache / staging buffer ---

config UBI_CRYPTO_PEB_CACHE
	bool "Enable PEB-sized staging buffer for secure I/O"
	default y
	help
	  Allocate a reusable eraseblock-sized buffer for encrypt/decrypt
	  staging. Required for the secure read/write paths.

config UBI_CRYPTO_PEB_CACHE_STATIC
	bool "Allocate PEB cache statically"
	depends on UBI_CRYPTO_PEB_CACHE
	help
	  Allocate the PEB staging buffer at compile time. When disabled,
	  the buffer is allocated per-device at init time using the selected
	  memory backend.

# --- Freshness ---

config UBI_CRYPTO_FRESHNESS_SYNC_DELTA
	int "Mutations between freshness-sync callbacks"
	default 0
	range 0 65535
	help
	  Number of flash-mutating operations between sync_freshness
	  callbacks. 0 means sync after every commit. Higher values reduce
	  callback frequency at the cost of a larger rollback window.

# --- Strict read-only policies ---

config UBI_CRYPTO_STRICT_RO_ON_RNG_FAILURE
	bool "Enter read-only on RNG failure"
	default y
	help
	  When the platform RNG cannot produce a fresh salt, enter
	  read-only mode instead of only rejecting the current write.

config UBI_CRYPTO_STRICT_RO_ON_POLICY_FAILURE
	bool "Enter read-only on freshness policy rejection"
	default y
	help
	  When the check_freshness callback rejects at attach time or a
	  rollback policy mismatch is detected, enter read-only mode.

config UBI_CRYPTO_STRICT_RO_ON_FRESHNESS_SYNC_FAILURE
	bool "Enter read-only on freshness sync failure"
	default n
	help
	  When the sync_freshness callback returns an error, enter
	  read-only mode. The failing commit is NOT rolled back.

# --- Test infrastructure (not for production) ---

config UBI_CRYPTO_TEST_FAULT_INJECTION
	bool "Enable secure backend fault injection hooks"
	depends on UBI_TEST_FAULT_INJECTION
	help
	  Exposes test hooks for injecting failures into PSA crypto
	  operations (AEAD encrypt/decrypt, HKDF, RNG, freshness
	  callbacks). Used for testing secure backend error handling.
	  Do not enable in production builds.

endif # UBI_CRYPTO
```

## west.yml
```yaml
manifest:
  remotes:
    - name: zephyrproject-rtos
      url-base: https://github.com/zephyrproject-rtos

  projects:
    - name: zephyr
      remote: zephyrproject-rtos
      revision: v4.0.0
      import:
        name-allowlist:
          - cmsis
          - hal_nordic
          - hal_stm32

  self:
    path: module/lib/ubi
```
